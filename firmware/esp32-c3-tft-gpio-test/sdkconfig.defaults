## firmware/esp32-c3-tft-gpio-test/sdkconfig.defaults
```kconfig
CONFIG_IDF_TARGET="esp32c3"

# LVGL 字体（小屏够用）
CONFIG_LV_FONT_MONTSERRAT_14=y
CONFIG_LV_FONT_MONTSERRAT_20=y
CONFIG_LV_FONT_MONTSERRAT_28=y
CONFIG_LV_COLOR_DEPTH_16=y

# 主任务栈加大（UI 构建在 main task 里）
CONFIG_ESP_MAIN_TASK_STACK_SIZE=8192

# 不需要 TLS，跳过 x509_crt_bundle 生成（避免 Python 架构问题）
CONFIG_MBEDTLS_CERTIFICATE_BUNDLE=n
CONFIG_MBEDTLS_CERTIFICATE_BUNDLE_DEFAULT_FULL=n
CONFIG_MBEDTLS_CERTIFICATE_BUNDLE_DEFAULT_CMN=n
CONFIG_MBEDTLS_CERTIFICATE_BUNDLE_DEFAULT_NONE=n
CONFIG_MBEDTLS_CERTIFICATE_BUNDLE_DEPRECATED_LIST=n
```

## firmware/esp32-s3-hw-dmc-test/sdkconfig.defaults
```kconfig
CONFIG_IDF_TARGET="esp32s3"
CONFIG_MBEDTLS_CERTIFICATE_BUNDLE=n
# 日志走 UART0 (调试口)
CONFIG_ESP_CONSOLE_UART_DEFAULT=y
```
